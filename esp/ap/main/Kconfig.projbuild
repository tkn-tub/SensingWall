## esp/ap/main/Kconfig.projbuild
```kconfig
menu "SensingWall Configuration"

    config ESP_WIFI_SSID
        string "WiFi SSID"
        default "sensing-wall"
        help
            SSID (network name) for WiFi network to be used.

    config ESP_WIFI_PASSWORD
        string "WiFi Password"
        default ""
        help
            WiFi password (WPA or WPA2) for the WiFi network to use.

    config ESP_WIFI_CHANNEL
        int "WiFi Channel"
        range 1 13
        default 6
        help
            WiFi channel (network channel) for the example to use.

    config ESP_MAX_STA_CONN
        int "Maximal STA connections"
        default 20
        help
            Max number of the STA connects to AP.

    config DB_HOST_MAC
        string "DB WiFi-MAC Address"
        default "94:e2:3c:46:ff:78"
        help
            MAC address of the Wifi interface of the database host.

    config DB_HOST_IP
        string "DB WiFi-IP Address"
        default "192.168.4.11"
        help
            IP address of the Wifi interface of database host.

    config IP_MCAST_INTERVAL
        int "Interval in ms between two IP multicast packets"
        default 20
        help
            Interval in ms between two IP multicast packets.
endmenu
```

## esp/ap/sdkconfig.defaults
```kconfig
#
# Sensing wall
#
CONFIG_DB_HOST_MAC="d8:3b:bf:7c:1e:06"
CONFIG_DB_HOST_IP="192.168.4.11"
CONFIG_IP_MCAST_INTERVAL=20

#
# Other
#
CONFIG_ESP32_WIFI_CSI_ENABLED=y
CONFIG_ESP_WIFI_SSID="sensing-wall"
CONFIG_ESP_WIFI_PASSWORD=""
CONFIG_ESP_WIFI_CHANNEL=6
# CONFIG_ESP32_WIFI_AMPDU_TX_ENABLED is not set
CONFIG_ESP_DEFAULT_CPU_FREQ_MHZ_240=y
CONFIG_ESP_DEFAULT_CPU_FREQ_MHZ=240
CONFIG_ESP_MAX_STA_CONN=20

CONFIG_LWIP_DHCPS_MAX_STATION_NUM=18
CONFIG_FREERTOS_HZ=1000
# CONFIG_ESP_CONSOLE_UART_BAUDRATE=921600
# CONFIG_ESP_CONSOLE_UART_CUSTOM=y
# CONFIG_ESP_CONSOLE_UART=y
# CONFIG_ESP_CONSOLE_UART_NUM=0
# CONFIG_CONSOLE_UART_BAUDRATE=921600
```

## esp/station/main/Kconfig.projbuild
```kconfig
menu "SensingWall Configuration"

    config ESP_WIFI_SSID
        string "WiFi SSID"
        default "sensing-wall"
        help
            SSID (network name) for WiFi network to be used.

    config ESP_WIFI_PASSWORD
        string "WiFi Password"
        default ""
        help
            WiFi password (WPA or WPA2) for the WiFi network to use.

    config AP_BSSID
        string "DB WiFi-MAC Address"
        default "48:27:e2:3b:33:2d"
        help
            MAC address of the sensing wall WiFi AP.

    config DB_HOST_IP
        string "DB WiFi-IP Address"
        default "192.168.4.11"
        help
            IP address of the Wifi interface of database host.
endmenu
```
